## eza/arch/amd64/Kconfig
```kconfig
# amd64 configuration

mainmenu "MuString Kernel Configuration for amd64"

config AMD64
       def_bool y
       bool "AMD64 architecture"
       default ARCH = "amd64"
       select GENARCH_MM

menu "Processor features"
     depends on AMD64

config APIC
       bool "Use APIC"
       default y
       help
         Select this option if you want to use APIC instead of
         old-fation PIC

config SMP
       default y
       bool "Symmetric multi-processing support"
       select APIC

config NRCPUS
       int "Maximum number of CPUs (2-64)"
       range 2 64
       depends on SMP
       default "2"
       help
         Here you may specify number of CPUs supported by the kernel.
         You may enter any number between 2 and 64.

config IOMMU
       bool "Use IOMMU"
       default y

config GENARCH_MM
     def_bool y
     bool "Use generic page table operations"

endmenu

source "mm/Kconfig"
source "kernel/Kconfig"
source "tests/Kconfig"
source "ds/Kconfig"

config EMU
	bool "Make MuiString for running on emulator"
	default y
```

## ipc/Kconfig
```kconfig
menu "IPC settings"

config IPC_DEFAULT_CHANNELS
       int "Default maximum number of open channels per-process"
       default "128"

config IPC_DEFAULT_PORTS
       int "Default maximum number of created IPC ports per-process"
       default "32"

endmenu
```

## kernel/Kconfig
```kconfig
menu "Common MuString settings"

config ALWAYS_INLINE
       bool "Enable always inline functions"
       default y
       help
       Some functions in kernel marked as always inline. This means
       that these functions will always be inline even if you disabled compiler
       optimisation. Note: disabling of this option is not a very good idea, but in some
       cases(for example for debugging) it may have a sense.

config CORESERVERS_PERCPU_LAUNCH
       bool "Perform initial per-cpu deployment of coreservers."
       default n
       help
       To test SMP kernel functionality, sometimes it is useful to make core servers
       occupy all available CPUs in system.

config CORESERVERS_LAUNCH_DELAY
       int "Delay (in system clock ticks) between launching next core server."
       range 500 3000
       default 500

menu "Task settings"

config AUTOREMOVE_ORPHANS
     bool "Automatically remove zombies whose parent is 1 (init)"
     default y
     help
     If this option is set, any process whose parent has become 1 as a result
     of its real parent termination, will be automatically removed from the list
     of processes upon calling 'exit()', and won't require to call 'wait()' against
     it.

endmenu

menu "Scheduler settings"

config TRACE_CURRENT
       bool "Trace TID of the current process for each CPU."
       default n
       help
       By turning this option on kernel stores TID of the currently executed task
       in a special array variable defined as follows:
            tid_t __current_cpu_task[CONFIG_NRCPUS]

config THREADS_PER_PROCESS
       int "Maximum number of threads for a userspace process."
       range 4  128
       default 64

endmenu

menu "Realtime timers"

config TIMER_RBTREE
       bool "RB-Tree based representation of active kernel timers"
       default n
       help
       By default, kernel keeps track of all active timers in a form of sorted list
       to eleminate rebalance cost. Such an approach is quite good if you are not
       going to have lots of active timers. But when number of active timers rises,
       cost of list traversing may affect realtime. In such a case, by turning this
       option on you will gain serious search benefits.

config TIMER_GRANULARITY
       int "Granularity of timer major tick"
       range 32 64 
       default "32"
       help
       Granularity (in timer tick) of major tick.

config CACHED_MAJOR_TICKS
       int "Initial number of cached major ticks"
       range 16 128
       default "16"
       help
       Initial number of major ticks in the cache. If kernel can't find an active
       major ticks to a timer being created, it first tries to get a free on from
       the cache.

config MIN_CACHED_MAJOR_TICKS
       int "Minimum number of cached major ticks in the cache"
       range 4 128
       default 4
       help
       Minimum number of cached major ticks in the cache. If the number of cached
       major ticks falls below this value, the process which made this value to
       reach this edge (as a result of adding a timer) will allocate a new cached
       entry.

config MAX_DEFERRED_IRQ_ACTIONS_PER_TICK
       int "Maximum amount of deferred actions fired at one time."
       range 1 512 
       default "32"
       help
       Maximum amount of deferred interrupt actions kernel fires per at one time tick.
       If more than such amount of deferred actions are ready for firing at the same time,
       the rest of these actions will be processed during the next suitable suituation.

config MAX_DEFERRED_USERSPACE_ACTIONS
       int "Maximum amount of deferred actions performed upon returning to userspace."
       range 1 32
       default "2"
endmenu

endmenu

menu   "Kernel consoles"
choice 
       prompt  "Kernel default console"
       default DEFCONS_VGA

config DEFCONS_VGA
       bool "VGA"
       help
         Standard VGA console

config DEFCONS_SERIAL
       bool "Serial"
       help
         "Serial console"
endchoice

choice 
      prompt "Kernel fault console"
      default FAULTCONS_VGA

config FAULTCONS_VGA
      bool "VGA"
      help
        Output fault to VGA

config FAULTCONS_SERIAL
      bool "Serial"
      help
        Print faults information to serial console
endchoice
endmenu

menu   "Fault processing"

config SEND_SIGSEGV_ON_FAULTS
       bool "Send SIGSEGV on memory/protection faults."
       default n
endmenu

menu   "Debug options"

config DEBUG
       bool "Enable general debugging."
       default n

config DEBUG_IRQ_ACTIVITY
       bool "Debug incoming hardware IRQs (also local timer and IPI) to debug console."
       depends on DEBUG_SERIAL_CONSOLE
       default n

config DUMP_USPACE_STACK
       bool "Dump user-space stack after any exception occurs"
       default n

config NUM_STACKWORDS
       int "Number of stack words that will be printed during the stack dump."
       range 5 50
       default "5"

endmenu
```

## kernel/arch/Kconfig
```kconfig
mainmenu "MuString microkernel"

choice
      prompt "Select processor architecture"
      
config AMD64
       bool "AMD64"

endchoice

if AMD64
source "kernel/arch/amd64/Kconfig"
endif

source "kernel/mm/Kconfig"
source "kernel/Kconfig"
source "kernel/ipc/Kconfig"
```

## kernel/arch/amd64/Kconfig
```kconfig
config ARCH
       string
       default "amd64"

menu "AMD64 processor features"
     depends on AMD64

config APIC
       bool "Use APIC"
       default y
       help
         Select this option if you want to use APIC instead of
         old-fation PIC

config SMP
       default y
       bool "Symmetric multi-processing support"
       select APIC

config NRCPUS
       int "Maximum number of CPUs (2-64)" if SMP
       range 2 64 if SMP
       default "2" if SMP
       default "1" if !SMP
       help
         Here you may specify number of CPUs supported by the kernel.
         You may enter any number between 2 and 64.

config IOMMU
       bool "Use IOMMU"
       default n

config GENARCH_MM
     def_bool y
     bool "Use generic page table operations"

endmenu
```

## kernel/ds/Kconfig
```kconfig
# data-structures configuration

menu "Data structures settings (advanced)"

config DEBUG_TTREE
       bool "Enable T*-tree debugging"
       default n
       help
         If enabled various runtime checkings will be applied and
         some verbose information will print on screen. Actually
         it won't significantly slow down T*-tree speed.

endmenu
```

## kernel/mm/Kconfig
```kconfig
# main memory manager configuration

menu "Memory manager"

config KCORE_STACK_PAGES
       int "Kernel core stack pages"
       range 2 8
       default "2"
       help
         You may specify number of kernel core stack pages.
         Strictly speaking it's a kernel stack size.

choice 
       prompt "Choice default page allocator"
       default TLSF

config TLSF
       bool "TLSF O(1) allocator"

endchoice

config DEBUG_MM
       bool "Enable memory manager main debugging"
       default n
       help
         Enable general memory manager debugging. If the option is enabled
         various runtime checks and special debug functions will execute.
         Also some debug API will be compiled.

config DEBUG_PTABLE
       bool "Debug low-level page table interface"
       default n
       select DEBUG_MM
       help
         Enabling of this option causes displaying of various page-tables related
         verbose information and some external runtime checks. In general it shouldn't
         strongly affect the speed.

endmenu
```

## mm/Kconfig
```kconfig
# main memory manager configuration

config IDALLOC_PAGES
       int "Numer of pages for init-data allocator"
       range 1 8
       default "2"
       help
         Init-data allocator is used for dynamic allocation of memory
         that is not going to be freed by anybody. This is useful
         when size of some intial object can not be strictly determined
         and depends on various different options. If you don't want to deal
         with wood of ifdef's, you may use idalloc which has limited memory pool.
         Here you may specify size of this pool in pages.         

choice
        prompt "Select page allocator"
        ---help---
        Here you may select physical page frames allocator

          
config PFA_TLSF
       bool "TLSF"

endchoice

config PFA_MAX_PAGES
       int "Max quantity of page frames system may allocate dynamically"
       range 32 2048
       default "256"
       help
         Max number of pages given page allocator may allocate.

config DEBUG_MM
       bool "Enable memory manager main debugging"

config DEBUG_SLAB
       bool "Enable slab allocator debugging"
```

## tests/Kconfig
```kconfig
menuconfig TEST
        bool "Make MuString with tests included"
        default n

if TEST
config TEST_IGNORE_FAILS
       bool "Ignore tescase fails"
       default n
       help
	 Continue running testcases even if one of testscases fails.
	 If this function is set to 'n', the test framework stops testing
	 after the first fail occures.

config TEST_IPC
       bool "IPC test"
       default n

config TEST_WQ
       bool "Wait queue test"
       default n

config TEST_SCHEDULER
       bool "Scheduler test"
       default n

config TEST_USYNC
       bool "Userspace synchronization test"
       default n

config TEST_SIGNALS
       bool "Signal subsystem test"
       default n

config TEST_TLSF
       bool "TLSF memory allocator test"
       default n
       select DEBUG_MM

config TEST_MAPUNMAP
       bool "Map/Unmap general test"
       default n
       select DEBUG_PTABLE

config TEST_VMA
       bool "Test general VMA functinality"
       default n

endif
```
